## boards/shields/mnsplptb/Kconfig.defconfig
```kconfig
if SHIELD_MNSPLPTB_RIGHT

config ZMK_KEYBOARD_NAME
    default "mnsplptb"

endif

if SHIELD_MNSPLPTB_LEFT || SHIELD_MNSPLPTB_RIGHT

config ZMK_SPLIT
    default y

endif
```

## boards/shields/mnsplptb/Kconfig.shield
```kconfig
config SHIELD_MNSPLPTB_LEFT
    def_bool $(shields_list_contains,mnsplptb_left)
config SHIELD_MNSPLPTB_RIGHT
    def_bool $(shields_list_contains,mnsplptb_right)
```
